## boards/shields/skeletyl/Kconfig.defconfig
```kconfig
# Copyright (c) 2020 The ZMK Contributors
# SPDX-License-Identifier: MIT

if SHIELD_skeletyl_LEFT

config ZMK_KEYBOARD_NAME
    default "skeletyl"

config ZMK_SPLIT_ROLE_CENTRAL
    default y

endif

if SHIELD_skeletyl_LEFT || SHIELD_skeletyl_RIGHT

config ZMK_SPLIT
    default y

endif
```

## boards/shields/skeletyl/Kconfig.shield
```kconfig
# Copyright (c) 2022 The ZMK Contributors
# SPDX-License-Identifier: MIT

config SHIELD_skeletyl_LEFT
    def_bool $(shields_list_contains,skeletyl_left)

config SHIELD_skeletyl_RIGHT
    def_bool $(shields_list_contains,skeletyl_right)
```
